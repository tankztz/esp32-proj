## programs/04-touch-ui-shell/sdkconfig.defaults
```kconfig
CONFIG_ESPTOOLPY_FLASHMODE_DIO=y
CONFIG_ESPTOOLPY_FLASHFREQ_40M=y
CONFIG_ESPTOOLPY_FLASHSIZE_16MB=y
CONFIG_ESPTOOLPY_FLASHSIZE="16MB"
CONFIG_SPIRAM=y
CONFIG_SPIRAM_TYPE_AUTO=y
CONFIG_SPIRAM_SPEED_40M=y
CONFIG_SPIRAM_USE_CAPS_ALLOC=y
```

## programs/05-mimiclaw-port/sdkconfig.defaults.esp32
```kconfig
# MimiClaw ESP32-D0WDQ6 port target configuration.
# Board validated in HARDWARE.md: 16MB flash, 8MB SPI PSRAM, CP210x UART.

CONFIG_IDF_TARGET="esp32"

# Flash 16MB + DIO. QIO is not used by the current board backups/tests.
CONFIG_ESPTOOLPY_FLASHSIZE_16MB=y
CONFIG_ESPTOOLPY_FLASHSIZE="16MB"
CONFIG_ESPTOOLPY_FLASHMODE_DIO=y
CONFIG_ESPTOOLPY_FLASHFREQ_40M=y

# CPU 240MHz.
CONFIG_ESP_DEFAULT_CPU_FREQ_MHZ_240=y

# ESP32 external SPI PSRAM. The board reports 64Mbit / 8MB PSRAM at 40MHz.
CONFIG_SPIRAM=y
CONFIG_SPIRAM_TYPE_AUTO=y
CONFIG_SPIRAM_SPEED_40M=y
CONFIG_SPIRAM_USE_CAPS_ALLOC=y
CONFIG_SPIRAM_MALLOC_ALWAYSINTERNAL=2048
CONFIG_SPIRAM_MALLOC_RESERVE_INTERNAL=98304
CONFIG_SPIRAM_MEMTEST=n

# Wi-Fi memory optimization.
CONFIG_ESP_WIFI_STATIC_RX_BUFFER_NUM=3
CONFIG_ESP_WIFI_DYNAMIC_RX_BUFFER_NUM=6
CONFIG_ESP_WIFI_RX_BA_WIN=3
CONFIG_LWIP_TCPIP_RECVMBOX_SIZE=16

# TLS optimization.
CONFIG_MBEDTLS_EXTERNAL_MEM_ALLOC=y
CONFIG_MBEDTLS_DYNAMIC_FREE_CONFIG_DATA=y
CONFIG_MBEDTLS_SSL_IN_CONTENT_LEN=16384
CONFIG_MBEDTLS_SSL_OUT_CONTENT_LEN=4096

# WebSocket support.
CONFIG_HTTPD_WS_SUPPORT=y

# Custom partition table.
CONFIG_PARTITION_TABLE_CUSTOM=y
CONFIG_PARTITION_TABLE_CUSTOM_FILENAME="partitions.csv"

# Console over the CP210x UART bridge, not ESP32-S3 USB Serial/JTAG.
CONFIG_ESP_CONSOLE_UART_DEFAULT=y
```
